## meta-xensiv-bgt60trxx/conf/layer.conf
```bitbake
# We have a conf and classes directory, add to BBPATH
BBPATH .= ":${LAYERDIR}"

# We have recipes-* directories, add to BBFILES
BBFILES += "${LAYERDIR}/recipes-*/*/*.bb \
            ${LAYERDIR}/recipes-*/*/*.bbappend"

BBFILE_COLLECTIONS += "meta-xensiv-bgt60trxx"
BBFILE_PATTERN_meta-xensiv-bgt60trxx = "^${LAYERDIR}/"
BBFILE_PRIORITY_meta-xensiv-bgt60trxx = "6"

LAYERDEPENDS_meta-xensiv-bgt60trxx = "core openembedded-layer"
LAYERSERIES_COMPAT_meta-xensiv-bgt60trxx = "kirkstone langdale mickledore nanbield scarthgap"

# Layer version
LAYERVERSION_meta-xensiv-bgt60trxx = "1"
```
